/*
 * Core tests, run on the host against port_sim.
 *
 * The vectors in vectors/vectors.h are generated by the Python reference
 * implementation. Asserting against them is what stops the C core and
 * the reference drifting apart silently - which matters because the
 * reference is the executable form of the specification.
 */
#include <stdio.h>
#include <string.h>

#include "loraitp.h"
#include "loraitp_frame.h"
#include "loraitp_internal.h"
#include "port_sim.h"
#include "vectors/vectors.h"

/* Generous, and checked at run time rather than assumed. */
#define SIM_MEM (256u * 1024u)
#define CTX_MEM (64u * 1024u)

static int passed, failed;

static void check(int cond, const char *name, const char *fmt, ...)
{
    (void)fmt;
    if (cond) { passed++; printf("  ok   %s\n", name); }
    else      { failed++; printf("  FAIL %s\n", name); }
}

#define CHECK(cond, name) check((cond), (name), "")

static void hexdiff(const char *what, const uint8_t *got, size_t gl,
                    const uint8_t *want, size_t wl)
{
    printf("       %s: got %zu B, want %zu B\n", what, gl, wl);
    for (size_t i = 0; i < (gl < wl ? gl : wl); i++)
        if (got[i] != want[i]) {
            printf("       first difference at byte %zu: %02x vs %02x\n",
                   i, got[i], want[i]);
            return;
        }
}

/* ------------------------------------------------------------- timing */

static void test_toa(void)
{
    printf("\ntime on air (against tools/airtime.py)\n");
    int bad = 0;
    uint32_t worst = 0;
    for (int i = 0; i < N_TOA_VECS; i++) {
        const toa_vec_t *v = &toa_vecs[i];
        uint32_t got = loraitp_time_on_air_us(v->pl, v->sf, v->bw, v->cr, 8);
        uint32_t d = got > v->us ? got - v->us : v->us - got;
        if (d > worst) worst = d;
        if (d > 2) {          /* 2 us of integer rounding is acceptable */
            bad++;
            printf("       SF%u PL%u BW%u: %u us vs %u us\n",
                   v->sf, v->pl, v->bw, got, v->us);
        }
    }
    CHECK(bad == 0, "all 34 vectors match to within 2 us");
    printf("       worst deviation %u us\n", worst);

    CHECK(loraitp_max_payload_for_toa(12, 125000, 1, 2000000) == 40,
          "SF12 payload within a 2 s cap is 40 B");
    CHECK(loraitp_max_payload_for_toa(7, 125000, 1, 2000000) == 255,
          "SF7 is not capped at 2 s");
    /* SF9 needs -12.5 dB, so -5 dB leaves 7.5 - the first with 6 dB spare. */
    CHECK(loraitp_choose_sf(-20, 24) == 9, "SF chosen with 6 dB margin");
    CHECK(loraitp_choose_sf(-120, 24) == 12, "worst SNR falls back to SF12");
}

/* ------------------------------------------------------------- frames */

static void test_frames(void)
{
    printf("\nwire format (against the reference encoder)\n");
    uint8_t buf[300];

    const uint8_t cs[] = "DL1ABC";
    loraitp_meta_t m;
    memset(&m, 0, sizeof(m));
    m.sid = 7; m.img_id = 1842; m.layer = 1; m.img_len = 10000;
    m.chunk = 196; m.codec = 2; m.crc32 = 0xDEADBEEFu;
    m.width = 320; m.height = 240;
    m.flags = LORAITP_F_BCAST | LORAITP_F_PARITY;
    m.block = 128; m.n_parity = 39;
    m.nonce[0] = 1; m.nonce[1] = 2; m.nonce[2] = 3; m.nonce[3] = 4;
    m.tlv[0].type = 1; m.tlv[0].len = 6; m.tlv[0].value = cs; m.n_tlv = 1;

    int n = loraitp_encode_meta(&m, buf, sizeof(buf));
    int same = (n == (int)sizeof(meta_expected))
               && memcmp(buf, meta_expected, (size_t)n) == 0;
    CHECK(same, "META encodes byte-for-byte like the reference");
    if (!same) hexdiff("META", buf, (size_t)n, meta_expected,
                       sizeof(meta_expected));

    loraitp_meta_t back;
    CHECK(loraitp_decode_meta(meta_expected, sizeof(meta_expected), &back)
          == LORAITP_OK, "META decodes");
    CHECK(back.img_id == 1842 && back.chunk == 196 && back.block == 128
          && back.n_parity == 39 && back.crc32 == 0xDEADBEEFu,
          "META fields survive the round trip");
    CHECK(back.n_tlv == 1 && back.tlv[0].len == 6
          && memcmp(back.tlv[0].value, "DL1ABC", 6) == 0,
          "META TLV survives the round trip");

    CHECK(loraitp_meta_n_chunks(&m) == META_N_CHUNKS, "n_chunks derived");
    CHECK(loraitp_meta_n_blocks(&m) == META_N_BLOCKS, "n_blocks derived");
    CHECK(loraitp_meta_total_frames(&m) == META_TOTAL_FRAMES,
          "total_frames derived");

    uint16_t src_seq[] = {0, 1, 127, 128, 129};
    uint16_t par_seq[] = {0, 38, 39};
    int ord_ok = 1, oi = 0;
    for (unsigned i = 0; i < 5; i++)
        ord_ok &= (loraitp_frame_ordinal(&m, src_seq[i], false)
                   == ordinal_expected[oi++]);
    for (unsigned i = 0; i < 3; i++)
        ord_ok &= (loraitp_frame_ordinal(&m, par_seq[i], true)
                   == ordinal_expected[oi++]);
    CHECK(ord_ok, "frame ordinals match across a block boundary");

    uint8_t pl[16];
    for (int i = 0; i < 16; i++) pl[i] = (uint8_t)i;
    loraitp_data_t d = { 7, 513, pl, 16, false };
    n = loraitp_encode_data(&d, buf, sizeof(buf));
    CHECK(n == (int)sizeof(data_expected)
          && memcmp(buf, data_expected, (size_t)n) == 0,
          "DATA encodes byte-for-byte like the reference");
    CHECK(LORAITP_DATA_HDR == 4, "DATA header is 4 bytes");

    /* Malformed input must be rejected, not read past. */
    CHECK(loraitp_frame_type(NULL, 0) < 0, "null frame rejected");
    CHECK(loraitp_frame_type(buf, 1) < 0, "one-byte frame rejected");
    uint8_t badver[4] = { 0xE0, 1, 0, 0 };
    CHECK(loraitp_frame_type(badver, 4) == LORAITP_E_NOSUP,
          "unknown version rejected");
    uint8_t badmeta[LORAITP_META_HDR];
    memcpy(badmeta, meta_expected, LORAITP_META_HDR);
    badmeta[8] = 0;      /* chunk = 0 would divide by zero downstream */
    CHECK(loraitp_decode_meta(badmeta, sizeof(badmeta), &back)
          == LORAITP_E_ARG, "META with chunk=0 rejected");
    uint8_t badtlv[LORAITP_META_HDR + 2];
    memcpy(badtlv, meta_expected, LORAITP_META_HDR);
    badtlv[LORAITP_META_HDR] = 1;
    badtlv[LORAITP_META_HDR + 1] = 200;    /* overruns the frame */
    CHECK(loraitp_decode_meta(badtlv, sizeof(badtlv), &back)
          == LORAITP_E_ARG, "TLV that overruns the frame rejected");
}

/* --------------------------------------------------------------- STAT */

static void test_stat(void)
{
    printf("\nSTAT encoding\n");
    uint8_t body[255], buf[300];
    uint16_t missing[STAT_N_MISSING];
    for (int i = 0; i < STAT_N_MISSING; i++) missing[i] = stat_missing[i];

    for (int enc = 0; enc < 2; enc++) {
        int bl = loraitp_stat_encode_body(enc, missing, STAT_N_MISSING,
                                          STAT_BASE, body, sizeof(body));
        loraitp_stat_t s = { 7, 1, 2, (uint8_t)enc, -98, -40,
                             body, (uint8_t)bl, STAT_BASE };
        int n = loraitp_encode_stat(&s, buf, sizeof(buf));
        const uint8_t *want = enc ? stat_list_expected : stat_bitmap_expected;
        size_t wl = enc ? sizeof(stat_list_expected)
                        : sizeof(stat_bitmap_expected);
        int same = (n == (int)wl) && memcmp(buf, want, wl) == 0;
        CHECK(same, enc ? "STAT list matches the reference"
                        : "STAT bitmap matches the reference");
        if (!same) hexdiff("STAT", buf, (size_t)n, want, wl);

        loraitp_stat_t dec;
        CHECK(loraitp_decode_stat(want, wl, STAT_BASE, &dec) == LORAITP_OK,
              enc ? "STAT list decodes" : "STAT bitmap decodes");
        uint16_t out[64];
        int got = loraitp_stat_decode_body(&dec, out, 64);
        int ok = (got == STAT_N_MISSING);
        for (int i = 0; ok && i < got; i++) ok &= (out[i] == missing[i]);
        CHECK(ok, enc ? "STAT list recovers the missing set"
                      : "STAT bitmap recovers the missing set against its base");
    }

    /* The crossover the reference measured. */
    uint16_t spread[40];
    int cross = 0;
    for (int n = 1; n < 40 && !cross; n++) {
        for (int i = 0; i < n; i++)
            spread[i] = (uint16_t)(n > 1 ? (i * 127 + (n - 1) / 2) / (n - 1)
                                         : 127);
        if (loraitp_stat_choose_enc(spread, (uint16_t)n, 0)
            == LORAITP_ENC_BITMAP)
            cross = n;
    }
    CHECK(cross == STAT_CROSSOVER, "bitmap/list crossover matches the reference");
    printf("       crossover at %d of 128 missing (%.1f%%)\n",
           cross, 100.0 * cross / 128.0);

    CHECK(loraitp_stat_choose_enc(NULL, 0, 0) == LORAITP_ENC_COMPLETE,
          "no losses encodes as COMPLETE");
}

/* ---------------------------------------------------------------- CRC */

static void test_crc(void)
{
    printf("\nCRC-32 (against zlib)\n");
    CHECK(loraitp_crc32(crc_input, sizeof(crc_input)) == CRC_EXPECTED,
          "CRC-32 over 1000 bytes matches zlib");

    uint32_t inc = 0;
    for (size_t off = 0; off < sizeof(crc_input); off += 196)
        inc = loraitp_crc32_update(inc, crc_input + off,
                                   (sizeof(crc_input) - off < 196)
                                   ? sizeof(crc_input) - off : 196);
    CHECK(inc == CRC_EXPECTED, "incremental CRC matches the one-shot");
}

/* --------------------------------------------------------------- CMAC */

static void test_cmac(void)
{
    printf("\nAES-128-CMAC (RFC 4493)\n");
    static uint8_t simmem[SIM_MEM];
    static uint8_t img[16];
    struct loraitp_sim *sim = loraitp_sim_new(simmem, sizeof(simmem), img,
                                              sizeof(img), cmac_key);
    CHECK(sim != NULL, "sim port fits its buffer");
    if (sim == NULL) return;
    loraitp_port_t port;
    loraitp_sim_port(&port, sim);

    uint8_t out[16];
    CHECK(loraitp_cmac(&port, NULL, 0, NULL, 0, out, 16) == LORAITP_OK
          && memcmp(out, cmac_tag0, 16) == 0, "CMAC of the empty message");
    CHECK(loraitp_cmac(&port, NULL, 0, cmac_msg16, 16, out, 16) == LORAITP_OK
          && memcmp(out, cmac_tag16, 16) == 0, "CMAC of one full block");

    /* nonce || msg must equal the concatenation, without concatenating. */
    uint8_t joined[20];
    memcpy(joined, cmac_key, 4);
    memcpy(joined + 4, cmac_msg16, 16);
    uint8_t a[16], b[16];
    loraitp_cmac(&port, cmac_key, 4, cmac_msg16, 16, a, 16);
    loraitp_cmac(&port, NULL, 0, joined, 20, b, 16);
    CHECK(memcmp(a, b, 16) == 0, "prepended nonce equals concatenation");

    /* SPEC.md 11: which frames carry a MAC. */
    CHECK(loraitp_frame_is_authenticated(LORAITP_META, false), "META is authenticated");
    CHECK(loraitp_frame_is_authenticated(LORAITP_STAT, false), "STAT is authenticated");
    CHECK(!loraitp_frame_is_authenticated(LORAITP_DATA, false),
          "DATA is not authenticated by default");
    CHECK(loraitp_frame_is_authenticated(LORAITP_DATA, true),
          "MAC_DATA authenticates DATA");
    CHECK(!loraitp_frame_is_authenticated(LORAITP_IDENT, true),
          "IDENT is never authenticated");

    uint8_t nonce[4] = { 9, 9, 9, 9 };
    uint8_t frame[64];
    int fl = loraitp_encode_simple(LORAITP_EOB, 3, NULL, 0, frame, sizeof(frame));
    int sealed = loraitp_seal(&port, nonce, false, frame, (size_t)fl,
                              sizeof(frame));
    CHECK(sealed == fl + LORAITP_MAC_LEN, "seal appends 4 bytes");
    CHECK(loraitp_unseal(&port, nonce, false, frame, (size_t)sealed) == fl,
          "valid MAC accepted");
    frame[sealed - 1] ^= 1;
    CHECK(loraitp_unseal(&port, nonce, false, frame, (size_t)sealed) < 0,
          "forged MAC rejected");
    frame[sealed - 1] ^= 1;
    uint8_t other[4] = { 1, 1, 1, 1 };
    CHECK(loraitp_unseal(&port, other, false, frame, (size_t)sealed) < 0,
          "wrong session nonce rejected");

    /* REGRESSION: META carries the nonce its own MAC would need. */
    uint8_t mbuf[300];
    loraitp_meta_t m;
    loraitp_decode_meta(meta_expected, sizeof(meta_expected), &m);
    int ml = loraitp_encode_meta(&m, mbuf, sizeof(mbuf));
    int ms = loraitp_seal(&port, m.nonce, false, mbuf, (size_t)ml, sizeof(mbuf));
    uint8_t zero[4] = { 0, 0, 0, 0 };
    CHECK(loraitp_unseal(&port, zero, false, mbuf, (size_t)ms) == ml,
          "REGRESSION: META verifies before its nonce is known");
}

/* ---------------------------------------------------------------- FEC */

static void test_fec(void)
{
    printf("\nReed-Solomon over GF(256)\n");
    static uint8_t parity[RS_R * RS_CHUNK];
    CHECK(loraitp_fec_encode(rs_data, RS_K, RS_CHUNK, parity, RS_R)
          == LORAITP_OK, "encode succeeds");
    CHECK(memcmp(parity, rs_parity, sizeof(parity)) == 0,
          "parity matches the reference byte-for-byte");

    CHECK(loraitp_fec_encode(rs_data, 200, RS_CHUNK, parity, 100)
          == LORAITP_E_ARG, "k + r > 255 refused");

    static uint8_t all[(RS_K + RS_R) * RS_CHUNK];
    static uint8_t scratch[4096];
    uint8_t work[RS_CHUNK];
    uint8_t present[RS_K + RS_R];

    /* Every way of losing exactly r frames must recover. */
    int recovered = 0, attempts = 0;
    unsigned seed = 12345u;
    for (int trial = 0; trial < 60; trial++) {
        memcpy(all, rs_data, RS_K * RS_CHUNK);
        memcpy(all + RS_K * RS_CHUNK, rs_parity, RS_R * RS_CHUNK);
        for (int i = 0; i < RS_K + RS_R; i++) present[i] = 1;

        int lost = 0;
        while (lost < RS_R) {
            seed = seed * 1103515245u + 12345u;
            int idx = (int)((seed >> 16) % (RS_K + RS_R));
            if (present[idx]) {
                present[idx] = 0;
                memset(all + idx * RS_CHUNK, 0xEE, RS_CHUNK);
                lost++;
            }
        }
        attempts++;
        if (loraitp_fec_decode(all, present, RS_K, RS_R, RS_CHUNK, scratch,
                               sizeof(scratch), work) == LORAITP_OK
            && memcmp(all, rs_data, RS_K * RS_CHUNK) == 0)
            recovered++;
    }
    CHECK(recovered == attempts, "recovers from exactly r erasures, 60 patterns");

    /* r+1 must fail, and fail cleanly. */
    memcpy(all, rs_data, RS_K * RS_CHUNK);
    memcpy(all + RS_K * RS_CHUNK, rs_parity, RS_R * RS_CHUNK);
    for (int i = 0; i < RS_K + RS_R; i++) present[i] = 1;
    for (int i = 0; i <= RS_R; i++) present[i] = 0;
    CHECK(loraitp_fec_decode(all, present, RS_K, RS_R, RS_CHUNK, scratch,
                             sizeof(scratch), work) == LORAITP_E_TIMEOUT,
          "r+1 erasures reported as unrecoverable");
    CHECK(loraitp_fec_decode(all, present, RS_K, RS_R, RS_CHUNK, scratch,
                             8, work) == LORAITP_E_ARG,
          "undersized scratch refused");
}

/* ----------------------------------------------------------- governor */

static uint32_t fake_now;
static uint32_t fake_now_fn(void *ctx) { (void)ctx; return fake_now; }

static void test_governor(void)
{
    printf("\nduty-cycle governor\n");
    loraitp_session_cfg_t cfg;
    loraitp_gov_t g;

    struct { loraitp_region_t r; uint32_t toa, off; } offs[] = {
        { LORAITP_REG_EU868_G1, 1850, 183150 },
        { LORAITP_REG_EU868_G3, 1850,  16650 },
        { LORAITP_REG_EU868_G2, 1850, 1848150 },
    };
    for (unsigned i = 0; i < 3; i++) {
        memset(&cfg, 0, sizeof(cfg));
        cfg.region = offs[i].r;
        cfg.bandwidth_hz = 125000;
        cfg.tx_power_dbm = 7;
        CHECK(loraitp_gov_init(&g, &cfg) == LORAITP_OK, "governor init");
        fake_now = 0;
        loraitp_gov_record(&g, 0, offs[i].toa);
        uint32_t got = g.blocked_until - offs[i].toa;
        CHECK(got == offs[i].off, loraitp_region(offs[i].r)->name);
        if (got != offs[i].off)
            printf("       off-time %u ms, expected %u\n", got, offs[i].off);
    }

    CHECK(loraitp_region_budget_ms(LORAITP_REG_EU868_G1) * 24 / 1000 == 864,
          "g1 daily budget is 864 s");
    CHECK(loraitp_region_budget_ms(LORAITP_REG_EU868_G3) * 24 / 1000 == 8640,
          "g3 daily budget is 8640 s");
    CHECK(loraitp_region_budget_ms(LORAITP_REG_EU868_G4_LP) == 0,
          "unlimited regions report no budget");

    /* SPEC.md 6.4 - hard refusals. */
    memset(&cfg, 0, sizeof(cfg));
    cfg.region = LORAITP_REG_AMATEUR;
    cfg.frequency_hz = 433500000; cfg.bandwidth_hz = 125000;
    CHECK(loraitp_gov_init(&g, &cfg) == LORAITP_E_CALLSIGN,
          "AMATEUR without a call sign refused");
    cfg.callsign = "DL1ABC";
    cfg.flags = LORAITP_CFG_ENCRYPTED;
    CHECK(loraitp_gov_init(&g, &cfg) == LORAITP_E_CRYPTO,
          "AMATEUR with encryption refused");
    cfg.flags = 0; cfg.frequency_hz = 0;
    CHECK(loraitp_gov_init(&g, &cfg) == LORAITP_E_FREQ,
          "AMATEUR without a frequency refused");

    memset(&cfg, 0, sizeof(cfg));
    cfg.region = LORAITP_REG_EU868_G3;
    cfg.frequency_hz = 868100000; cfg.bandwidth_hz = 125000;
    CHECK(loraitp_gov_init(&g, &cfg) == LORAITP_E_FREQ,
          "frequency outside the sub-band refused");
    cfg.region = LORAITP_REG_EU868_G1; cfg.frequency_hz = 868300000;
    cfg.tx_power_dbm = 27;
    CHECK(loraitp_gov_init(&g, &cfg) == LORAITP_E_POWER,
          "power above the ERP limit refused");
    cfg.region = LORAITP_REG_EU433_NARROW; cfg.frequency_hz = 434500000;
    cfg.tx_power_dbm = 10; cfg.bandwidth_hz = 125000;
    CHECK(loraitp_gov_init(&g, &cfg) == LORAITP_E_BANDWIDTH,
          "bandwidth above a narrow-band limit refused");

    /* Rolling window, not a calendar hour. */
    memset(&cfg, 0, sizeof(cfg));
    cfg.region = LORAITP_REG_EU868_G1;
    cfg.frequency_hz = 868300000; cfg.bandwidth_hz = 125000; cfg.tx_power_dbm = 14;
    loraitp_gov_init(&g, &cfg);
    for (int i = 0; i < 20; i++)
        loraitp_gov_record(&g, (uint32_t)i * 100u, 1800);
    CHECK(loraitp_gov_airtime_in_window(&g, 2000) == 36000,
          "rolling window accumulates");
    CHECK(loraitp_gov_airtime_in_window(&g, 3600000u + 5000u) == 0,
          "entries older than Tobs drop out");

    /* The 49.7-day millisecond wrap must not confuse it. */
    memset(&g, 0, sizeof(g));
    loraitp_gov_init(&g, &cfg);
    uint32_t near_wrap = 0xFFFFF000u;
    loraitp_gov_record(&g, near_wrap, 1800);
    CHECK(loraitp_gov_airtime_in_window(&g, near_wrap + 5000u) == 1800,
          "accounting survives a 32-bit millisecond wrap");

    /* Amateur identification is due immediately and then on a timer. */
    memset(&cfg, 0, sizeof(cfg));
    cfg.region = LORAITP_REG_AMATEUR; cfg.callsign = "DL1ABC";
    cfg.frequency_hz = 433500000; cfg.bandwidth_hz = 125000; cfg.tx_power_dbm = 30;
    loraitp_gov_init(&g, &cfg);
    CHECK(loraitp_gov_ident_due(&g, 0), "IDENT due at session start");
    loraitp_gov_ident_sent(&g, 0);
    CHECK(!loraitp_gov_ident_due(&g, 100000u), "IDENT not due after 100 s");
    CHECK(loraitp_gov_ident_due(&g, 540000u), "IDENT due again after 540 s");
    (void)fake_now_fn;
}

/* --------------------------------------------------------- end to end */

static void test_transfer(void)
{
    printf("\nend to end through port_sim\n");
    static uint8_t image[4000];
    static uint8_t received[4000];
    for (size_t i = 0; i < sizeof(image); i++)
        image[i] = (uint8_t)((i * 37 + (i >> 5) * 11) & 0xFF);

    static uint8_t txmem[SIM_MEM], rxmem[SIM_MEM];
    static uint8_t ctxmem_a[CTX_MEM], ctxmem_b[CTX_MEM];

    struct loraitp_sim *tx = loraitp_sim_new(txmem, sizeof(txmem), image,
                                             sizeof(image), NULL);
    CHECK(tx != NULL, "sender sim fits its buffer");
    if (tx == NULL) return;
    loraitp_port_t tx_port;
    loraitp_sim_port(&tx_port, tx);

    loraitp_session_cfg_t cfg;
    memset(&cfg, 0, sizeof(cfg));
    cfg.mode = LORAITP_MODE_INTERACTIVE;
    cfg.region = LORAITP_REG_EU868_G3;
    cfg.frequency_hz = 869525000; cfg.bandwidth_hz = 125000;
    cfg.spreading_factor = 10; cfg.coding_rate = 1; cfg.tx_power_dbm = 27;
    cfg.session_timeout_ms = 4u * 3600000u;

    loraitp_ctx_t *sender = (loraitp_ctx_t *)ctxmem_a;
    CHECK(loraitp_ctx_size() <= sizeof(ctxmem_a), "context fits the buffer");
    printf("       sizeof(loraitp_ctx_t) = %zu bytes\n", loraitp_ctx_size());
    CHECK(loraitp_init(sender, &tx_port, &cfg) == LORAITP_OK, "sender init");

    loraitp_image_desc_t desc;
    memset(&desc, 0, sizeof(desc));
    desc.img_id = 42; desc.layer = 1; desc.img_len = sizeof(image);
    desc.codec = 2; desc.img_crc32 = loraitp_crc32(image, sizeof(image));
    desc.width = 320; desc.height = 240;

    loraitp_stats_t st;
    int rc = loraitp_send_image(sender, &desc, &st);
    CHECK(rc == LORAITP_OK || rc == LORAITP_E_IO, "sender completes");
    printf("       %u frames, %u ms airtime, %u rounds\n",
           st.frames_tx, st.airtime_ms, st.rounds);
    CHECK(st.frames_tx > 0, "sender transmitted");

    /* Feed everything the sender produced into a receiver. */
    memset(received, 0, sizeof(received));
    struct loraitp_sim *rx = loraitp_sim_new(rxmem, sizeof(rxmem), received,
                                             sizeof(received), NULL);
    if (rx == NULL) return;
    loraitp_port_t rx_port;
    loraitp_sim_port(&rx_port, rx);
    loraitp_sim_splice(rx, tx);   /* replay what the sender produced */

    loraitp_ctx_t *receiver = (loraitp_ctx_t *)ctxmem_b;
    CHECK(loraitp_init(receiver, &rx_port, &cfg) == LORAITP_OK, "receiver init");

    loraitp_image_desc_t got_desc;
    loraitp_rx_result_t result;
    loraitp_stats_t rst;
    CHECK(loraitp_receive_image(receiver, &got_desc, &result, &rst)
          == LORAITP_OK, "receiver completes");
    printf("       result %d, %u/%u chunks, %u frames in\n",
           (int)result, rst.chunks_have, rst.chunks_total, rst.frames_rx);
    CHECK(got_desc.img_id == 42 && got_desc.img_len == sizeof(image),
          "image descriptor recovered");
    CHECK(rst.chunks_have == rst.chunks_total, "all chunks received");
    CHECK(loraitp_crc32(received, sizeof(received)) == desc.img_crc32,
          "reassembled image matches the original CRC-32");
}

/*
 * Two transfers on one context. The governor's rolling window lives in
 * the context, so re-initialising between sessions silently resets the
 * duty-cycle accounting - every transfer then believes it has the whole
 * hourly budget to itself, and the limit the whole design rests on
 * becomes decoration. The firmware did exactly that until it was caught
 * by reading the code; this makes sure it stays caught.
 */
static void test_budget_persists(void)
{
    printf("\nduty-cycle accounting across sessions\n");
    static uint8_t image[2000];
    static uint8_t simmem[SIM_MEM];
    static uint8_t ctxmem[CTX_MEM];
    for (size_t i = 0; i < sizeof(image); i++)
        image[i] = (uint8_t)(i * 13);

    struct loraitp_sim *sim = loraitp_sim_new(simmem, sizeof(simmem), image,
                                              sizeof(image), NULL);
    loraitp_port_t p;
    loraitp_sim_port(&p, sim);

    loraitp_session_cfg_t cfg;
    memset(&cfg, 0, sizeof(cfg));
    cfg.mode = LORAITP_MODE_INTERACTIVE;
    cfg.region = LORAITP_REG_EU868_G1;      /* 1%, so a budget exists */
    cfg.frequency_hz = 868300000u;
    cfg.bandwidth_hz = 125000u;
    cfg.spreading_factor = 10;
    cfg.coding_rate = 1;
    cfg.tx_power_dbm = 14;
    cfg.session_timeout_ms = 60000u;

    loraitp_ctx_t *c = (loraitp_ctx_t *)ctxmem;
    CHECK(loraitp_init(c, &p, &cfg) == LORAITP_OK, "init once");

    loraitp_image_desc_t d;
    memset(&d, 0, sizeof(d));
    d.img_id = 1; d.layer = 1; d.img_len = sizeof(image); d.codec = 2;
    d.img_crc32 = loraitp_crc32(image, sizeof(image));

    loraitp_stats_t st;
    loraitp_send_image(c, &d, &st);
    loraitp_budget_t b1;
    loraitp_budget_query(c, &b1);
    CHECK(b1.airtime_used_ms > 0, "the first transfer is accounted for");

    d.img_id = 2;
    loraitp_send_image(c, &d, &st);
    loraitp_budget_t b2;
    loraitp_budget_query(c, &b2);
    CHECK(b2.airtime_used_ms > b1.airtime_used_ms,
          "the second adds to the first rather than replacing it");
    printf("       %u ms after one transfer, %u ms after two, of %u\n",
           b1.airtime_used_ms, b2.airtime_used_ms, b2.airtime_budget_ms);

    /* And a fresh context must start empty, or the test above proves
     * nothing about where the state actually lives. */
    static uint8_t ctx2[CTX_MEM];
    loraitp_ctx_t *c2 = (loraitp_ctx_t *)ctx2;
    loraitp_init(c2, &p, &cfg);
    loraitp_budget_t b3;
    loraitp_budget_query(c2, &b3);
    CHECK(b3.airtime_used_ms == 0, "a new context starts with an empty window");
}

int main(void)
{
    printf("LoRaITP core tests\n");
    printf("  sizeof(loraitp_ctx_t) = %zu B, sim port = %zu B\n",
           loraitp_ctx_size(), loraitp_sim_size());
    test_toa();
    test_frames();
    test_stat();
    test_crc();
    test_cmac();
    test_fec();
    test_governor();
    test_transfer();
    test_budget_persists();
    printf("\n%d passed, %d failed\n", passed, failed);
    return failed ? 1 : 0;
}
